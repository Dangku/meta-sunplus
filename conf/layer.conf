## conf/layer.conf
```bitbake
# We have a conf and classes directory, append to BBPATH
BBPATH .= ":${LAYERDIR}"

# We have a recipes directory, add to BBFILES
BBFILES += "${LAYERDIR}/recipes*/*/*.bb ${LAYERDIR}/recipes*/*/*.bbappend"

BBFILE_COLLECTIONS += "meta-sunplus"
BBFILE_PATTERN_meta-sunplus := "^${LAYERDIR}/"
BBFILE_PRIORITY_meta-sunplus = "10"

# This should only be incremented on significant changes that will
# cause compatibility issues with other layers
LAYERVERSION_meta-sunplus = "1"

LAYERDEPENDS_meta-sunplus = "core openembedded-layer"

LAYERSERIES_COMPAT_meta-sunplus = "zeus"
```

## conf/machine/bananapi-f2s.conf
```bitbake
#@TYPE: Machine
#@NAME: orange-pi-one
#@DESCRIPTION: Machine configuration for the orange-pi-one, base on allwinner H3 CPU

require conf/machine/include/sp7021.inc

KERNEL_DEVICETREE = "pentagram-sp7021-achip-bananapi-f2s.dtb"
UBOOT_MACHINE = "bananapi_f2s_defconfig"
KBUILD_DEFCONFIG_bananapi-f2s ?= "pentagram_sp7021_achip_emu_bpi-f2s_defconfig"
```

## conf/machine/include/sp7021.inc
```bitbake
require conf/machine/include/sunplus.inc
require conf/machine/include/tune-cortexa7.inc

SOC_FAMILY = "sp7021"
```

## conf/machine/include/sunplus.inc
```bitbake
SOC_FAMILY ??= ""
include conf/machine/include/soc-family.inc

#xf86-video-fbturbo
XSERVER = "xserver-xorg \
           xf86-video-fbdev \
           xf86-input-evdev \
           xf86-input-mouse \
           xf86-input-keyboard"

PREFERRED_PROVIDER_virtual/xserver = "xserver-xorg"
PREFERRED_PROVIDER_virtual/kernel ?= "linux-sp"
PREFERRED_PROVIDER_u-boot ?= "u-boot-sp"
PREFERRED_PROVIDER_virtual/bootloader ?= "u-boot-sp"

KERNEL_IMAGETYPE ?= "uImage"

IMAGE_CLASSES += "sdcard_image-sunplus"
IMAGE_FSTYPES += "ext3 tar.gz sunplus-sdimg"

MACHINE_EXTRA_RRECOMMENDS = "kernel-modules"

UBOOT_ENTRYPOINT ?= "0x00308000"

SPL_BINARY="ISPBOOOT.BIN"
UBOOT_BINARY="u-boot.img"

SERIAL_CONSOLE ?= "115200 ttyS0"
MACHINE_FEATURES ?= "alsa apm keyboard rtc serial screen usbgadget usbhost vfat"
```
